## boards/shields/1742909727370/Kconfig.defconfig
```kconfig
if SHIELD_1742909727370_LEFT

config ZMK_KEYBOARD_NAME
    default "1742909727370"

endif

if SHIELD_1742909727370_LEFT || SHIELD_1742909727370_RIGHT

config ZMK_SPLIT
    default y

endif
```

## boards/shields/1742909727370/Kconfig.shield
```kconfig
config SHIELD_1742909727370_LEFT
    def_bool $(shields_list_contains,1742909727370_left)
config SHIELD_1742909727370_RIGHT
    def_bool $(shields_list_contains,1742909727370_right)
```
